/*********************************************************************************************************************
* 水面垃圾收集船主控程序 — 视觉识别模块（占位实现）
* Copyright (c) 2025-2026
*
* 本文件是水面垃圾收集船主控程序的一部分
*
* 文件名称          vision.c
* 目标平台          GD32H759IMK6
* 编译环境          Keil MDK5 (uVision5)
*
* 功能              摄像头图像采集 + 垃圾目标检测（当前为占位，待与视觉工程合并）
*
* 架构说明
*                   原方案 UART_CAM 板间通信已废弃，视觉与控制合并到同一块 H7
*                   本模块定义完整的数据接口，视觉工程只需实现 Vision_Update() 内部逻辑
*                   其余模块（auto_nav / servo_arm / main）通过 Vision_GetFrame() 等
*                   标准接口获取检测结果，不受底层实现变化影响
*
* 修改记录
* 日期                作者          备注
* 2026-06-12          CIMC          初始版本：占位实现，定义接口框架
*********************************************************************************************************************/

#include "vision.h"
#include <string.h>

/* ---- 模块内部状态 ---- */
static VisionFrame  g_frame;            /* 最新一帧检测结果                    */
static uint8_t      g_ready = 0;        /* 模块就绪标志                        */
static uint32_t     g_frame_id = 0;     /* 帧计数器                            */

extern volatile uint32_t g_sys_ms;      /* 全局毫秒计数器 (SysTick ISR)        */

//=================================================== 公开接口实现 ====================================================

//-------------------------------------------------------------------------------------------------------------------
// 函数名称     Vision_Init
// 函数说明     初始化摄像头硬件 + 配置采集参数（占位）
//              TODO: 对接视觉工程后在此处完成：
//                    1. 使能摄像头及相关 GPIO 时钟
//                    2. 配置 DCI 接口 或 I2C (SCCB) 初始化摄像头寄存器
//                    3. 配置 DMA 用于帧传输（如需要）
//                    4. 初始化推理引擎（如使用 NPU / CMSIS-NN）
//-------------------------------------------------------------------------------------------------------------------
void Vision_Init(void)
{
    /* ---- 复位内部状态 ---- */
    memset(&g_frame, 0, sizeof(g_frame));
    g_frame_id = 0;
    g_ready = 0;

    /*
     * TODO: 摄像头硬件初始化
     *   示例（待视觉工程提供具体引脚和配置）:
     *     Camera_Init();           // DCI + I2C SCCB
     *     Camera_SetResolution(320, 240);
     *     Camera_SetFormat(RGB565);
     *
     *   初始化成功后:
     *     g_ready = 1;
     */

    /* 当前标记为未就绪，等待另一个工程填充实现 */
}

//-------------------------------------------------------------------------------------------------------------------
// 函数名称     Vision_Update
// 函数说明     采集一帧图像并执行目标检测（占位）
//             TODO: 对接视觉工程后替换为：
//                    1. 检查摄像头是否有新帧
//                    2. DMA 搬运 / 触发推理
//                    3. 解析推理结果 → 填充 g_frame
//-------------------------------------------------------------------------------------------------------------------
void Vision_Update(void)
{
    if (!g_ready) return;

    /*
     * TODO: 实际检测流程
     *   if (!Camera_FrameReady()) return;         // 无新帧则跳过
     *
     *   Camera_CaptureFrame();                     // 采集一帧
     *   Inference_Run();                           // 运行检测推理
     *
     *   g_frame.count = Inference_GetCount();
     *   for (int i = 0; i < g_frame.count; i++) {
     *       g_frame.targets[i].x_mm  = ...;
     *       g_frame.targets[i].y_mm  = ...;
     *       ...
     *   }
     *   g_frame.frame_id     = ++g_frame_id;
     *   g_frame.timestamp_ms = g_sys_ms;
     */
}

//-------------------------------------------------------------------------------------------------------------------
// 函数名称     Vision_GetFrame
// 函数说明     获取最近一帧的完整检测结果（只读指针）
//-------------------------------------------------------------------------------------------------------------------
const VisionFrame* Vision_GetFrame(void)
{
    if (!g_ready || g_frame.count == 0) {
        return NULL;
    }
    return &g_frame;
}

//-------------------------------------------------------------------------------------------------------------------
// 函数名称     Vision_HasTarget
// 函数说明     快速判断是否有检测到目标
//-------------------------------------------------------------------------------------------------------------------
uint8_t Vision_HasTarget(void)
{
    return (g_ready && g_frame.count > 0) ? 1 : 0;
}

//-------------------------------------------------------------------------------------------------------------------
// 函数名称     Vision_GetClosestTarget
// 函数说明     获取距离船最近的有效目标
//             遍历目标列表，返回 y_mm 最小（最近）且 confidence > 0 的目标
//-------------------------------------------------------------------------------------------------------------------
VisionTarget Vision_GetClosestTarget(void)
{
    VisionTarget none = {0};
    none.confidence = 0;

    if (!g_ready || g_frame.count == 0) {
        return none;
    }

    /* 找最近目标（y_mm 最小，即船头方向最近） */
    uint8_t best_idx = 0;
    float   best_y   = g_frame.targets[0].y_mm;

    for (uint8_t i = 1; i < g_frame.count; i++) {
        if (g_frame.targets[i].confidence > 0 &&
            g_frame.targets[i].y_mm < best_y) {
            best_y   = g_frame.targets[i].y_mm;
            best_idx = i;
        }
    }

    return g_frame.targets[best_idx];
}

//-------------------------------------------------------------------------------------------------------------------
// 函数名称     Vision_IsReady
// 函数说明     查询视觉模块是否已完成初始化并可正常使用
//-------------------------------------------------------------------------------------------------------------------
uint8_t Vision_IsReady(void)
{
    return g_ready;
}
