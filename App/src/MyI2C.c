/*******************************************************************************
 * 文件名          MyI2C.c
 * 描述            软件 I2C 时序实现（GPIO 位操作模拟）
 * MCU             GD32H759IMK6
 * IDE             Keil MDK5 (uVision5)
 *
 * 修改记录
 * 日期            作者            备注
 * 2026-05-06      AI助手          初始版本
 * 2026-05-21      CIMC            GD32F407→GD32H759 移植
 ******************************************************************************/

/**********************************************************************************************************************
 * 文件名          MyI2C.c
 * 描述            软件 I2C 时序实现（GPIO 位操作模拟）
 * 目标平台        GD32H7XXVET6
 * 引脚分配        PB10 → SCL, PB11 → SDA（可在 MyI2C.h 中修改）
 * 实现要点        GPIO 开漏输出 + 外部上拉电阻（或 MCU 内部弱上拉）
 *
 * 速        率      由 MyI2C_Delay() 的循环次数控制，默认 2857 次空循环
 *                  (原 F407@168MHz 为 800 次，H759@600MHz 按比例调整)
 *                  通信不稳定时可增大到 5000~7000，降低速率提高可靠性
 *
 * 使用注意：
 *   1. SCL 和 SDA 引脚必须外部接 4.7kΩ 上拉电阻到 3.3V
 *   2. 本模块仅实现主机模式，不支持多主机仲裁和时钟同步
 *   3. I2C 总线上的所有设备共享 SCL/SDA，靠不同器件地址区分
 **********************************************************************************************************************/
#include "gd32h7xx.h"
#include "MyI2C.h"

//-------------------------------------------------------------------------------------------------------------------
// 函数名称     MyI2C_Delay
// 函数说明     软件 I2C 时序延时（粗粒度延时，空循环实现）
//              调整循环次数可改变 I2C 通信速率：值越大速率越低、抗干扰能力越强
//              默认 2857 次循环 ≈ 标准模式 (100kHz) @600MHz
//              (原 F407@168MHz 为 800 次，按 600/168 比例调整)
//-------------------------------------------------------------------------------------------------------------------
static void MyI2C_Delay(void)
{
    volatile uint32_t i;
    for(i = 0; i < 2857; i++) {
        ;
    }
}

//-------------------------------------------------------------------------------------------------------------------
// 函数名称     MyI2C_W_SCL
// 函数说明     SCL 时钟线写操作（含延时）
// 参数         BitValue     1 = 高电平, 0 = 低电平
//-------------------------------------------------------------------------------------------------------------------
void MyI2C_W_SCL(uint8_t BitValue)
{
    if(BitValue) {
        gpio_bit_set(MYI2C_GPIO_PORT, MYI2C_SCL_PIN);
    } else {
        gpio_bit_reset(MYI2C_GPIO_PORT, MYI2C_SCL_PIN);
    }
    MyI2C_Delay();
}

//-------------------------------------------------------------------------------------------------------------------
// 函数名称     MyI2C_W_SDA
// 函数说明     SDA 数据线写操作（含延时）
// 参数         BitValue     1 = 高电平（释放总线）, 0 = 低电平（拉低总线）
//-------------------------------------------------------------------------------------------------------------------
void MyI2C_W_SDA(uint8_t BitValue)
{
    if(BitValue) {
        gpio_bit_set(MYI2C_GPIO_PORT, MYI2C_SDA_PIN);
    } else {
        gpio_bit_reset(MYI2C_GPIO_PORT, MYI2C_SDA_PIN);
    }
    MyI2C_Delay();
}

//-------------------------------------------------------------------------------------------------------------------
// 函数名称     MyI2C_R_SDA
// 函数说明     SDA 数据线读操作 —— 读取当前引脚电平（含延时）
// 返回值       引脚当前电平 (0 或 1)
//-------------------------------------------------------------------------------------------------------------------
uint8_t MyI2C_R_SDA(void)
{
    uint8_t BitValue;
    BitValue = gpio_input_bit_get(MYI2C_GPIO_PORT, MYI2C_SDA_PIN);
    MyI2C_Delay();
    return BitValue;
}

//-------------------------------------------------------------------------------------------------------------------
// 函数名称     MyI2C_Init
// 函数说明     初始化 I2C 总线引脚为开漏输出模式，释放总线到空闲状态（高电平）
//              在调用任何其他 I2C 函数之前必须首先调用此函数
//-------------------------------------------------------------------------------------------------------------------
void MyI2C_Init(void)
{
    rcu_periph_clock_enable(MYI2C_RCU_CLK);                         // 使能 GPIO 时钟

    gpio_mode_set(MYI2C_GPIO_PORT,                                  // 配置为输出模式
                  GPIO_MODE_OUTPUT,
                  GPIO_PUPD_NONE,                                    // 无内部上下拉（依赖外部上拉电阻）
                  MYI2C_SCL_PIN | MYI2C_SDA_PIN);

    gpio_output_options_set(MYI2C_GPIO_PORT,                        // 配置为开漏输出
                            GPIO_OTYPE_OD,                           // 开漏模式：输出 1 = 释放总线
                            GPIO_OSPEED_60MHZ,
                            MYI2C_SCL_PIN | MYI2C_SDA_PIN);

    gpio_bit_set(MYI2C_GPIO_PORT, MYI2C_SCL_PIN | MYI2C_SDA_PIN);  // 释放总线（高电平 = 空闲）
}

//-------------------------------------------------------------------------------------------------------------------
// 函数名称     MyI2C_Start
// 函数说明     发送 I2C 总线起始条件：SCL 高电平期间 SDA 从高变低
//              I2C 规范规定每次数据传输必须由主机发送起始条件开始
//-------------------------------------------------------------------------------------------------------------------
void MyI2C_Start(void)
{
    MyI2C_W_SDA(1);     // SDA 高（确保起始前总线空闲）
    MyI2C_W_SCL(1);     // SCL 高
    MyI2C_W_SDA(0);     // SCL 高期间 SDA 拉低 → 起始条件
    MyI2C_W_SCL(0);     // 拉低 SCL，准备传输数据
}

//-------------------------------------------------------------------------------------------------------------------
// 函数名称     MyI2C_Stop
// 函数说明     发送 I2C 总线停止条件：SCL 高电平期间 SDA 从低变高
//              数据传输结束后由主机发送停止条件释放总线
//-------------------------------------------------------------------------------------------------------------------
void MyI2C_Stop(void)
{
    MyI2C_W_SDA(0);     // SDA 低（确保停止前 SDA 为低）
    MyI2C_W_SCL(1);     // SCL 高
    MyI2C_W_SDA(1);     // SCL 高期间 SDA 拉高 → 停止条件
}

//-------------------------------------------------------------------------------------------------------------------
// 函数名称     MyI2C_SendByte
// 函数说明     向 I2C 总线发送一个字节，高位 (MSB) 先行
//              每发送一位数据后产生一个 SCL 时钟脉冲
// 参数         Byte     待发送的 8 位数据
//-------------------------------------------------------------------------------------------------------------------
void MyI2C_SendByte(uint8_t Byte)
{
    uint8_t i;
    for(i = 0; i < 8; i++) {
        // 按高位到低位的顺序逐位发送
        if(Byte & (0x80 >> i)) {
            MyI2C_W_SDA(1);             // 当前位为 1 → SDA 高
        } else {
            MyI2C_W_SDA(0);             // 当前位为 0 → SDA 低
        }
        MyI2C_W_SCL(1);                 // SCL 上升沿：从机采样 SDA 数据
        MyI2C_W_SCL(0);                 // SCL 下降沿：准备下一位数据
    }
}

//-------------------------------------------------------------------------------------------------------------------
// 函数名称     MyI2C_ReceiveByte
// 函数说明     从 I2C 总线接收一个字节，高位 (MSB) 先行
//              主机先释放 SDA，在 SCL 上升沿采样从机发出的数据
// 返回值       接收到的 8 位数据
//-------------------------------------------------------------------------------------------------------------------
uint8_t MyI2C_ReceiveByte(void)
{
    uint8_t i;
    uint8_t Byte = 0x00;

    MyI2C_W_SDA(1);                     // 主机释放 SDA（开漏输出 1），由从机驱动

    for(i = 0; i < 8; i++) {
        MyI2C_W_SCL(1);                 // SCL 上升沿：主机采样 SDA
        if(MyI2C_R_SDA() == 1) {
            Byte |= (0x80 >> i);        // 读到 1 → 对应位置位
        }
        MyI2C_W_SCL(0);                 // SCL 低：从机准备下一位数据
    }
    return Byte;
}

//-------------------------------------------------------------------------------------------------------------------
// 函数名称     MyI2C_SendAck
// 函数说明     主机向从机发送一位应答信号
// 参数         AckBit     0 = ACK（通知从机继续发送）, 1 = NACK（通知从机停止）
//-------------------------------------------------------------------------------------------------------------------
void MyI2C_SendAck(uint8_t AckBit)
{
    MyI2C_W_SDA(AckBit);                // 输出应答位
    MyI2C_W_SCL(1);                     // 产生应答时钟脉冲
    MyI2C_W_SCL(0);
}

//-------------------------------------------------------------------------------------------------------------------
// 函数名称     MyI2C_ReceiveAck
// 函数说明     主机接收从机发出的一位应答信号
//              在每次发送完一个字节（地址或数据）后必须调用此函数检查从机是否应答
// 返回值       0 = ACK（从机应答正常，通信成功）
//              1 = NACK（从机无应答，可能原因：器件不存在、地址错误、总线短路）
//-------------------------------------------------------------------------------------------------------------------
uint8_t MyI2C_ReceiveAck(void)
{
    uint8_t AckBit;

    MyI2C_W_SDA(1);                     // 释放 SDA 让从机驱动
    MyI2C_W_SCL(1);                     // SCL 高：采样从机的应答位
    AckBit = MyI2C_R_SDA();             // 读取应答：0=ACK, 1=NACK
    MyI2C_W_SCL(0);

    return AckBit;
}
